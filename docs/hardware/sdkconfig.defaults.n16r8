## firmware/components/wcs_auth/Kconfig
```kconfig
menu "ESP WCS: авторизация"

    config WCS_AUTH_MAX_SESSIONS
        int "Максимум одновременных сессий входа"
        range 1 16
        default 4
        help
            При превышении вытесняется самая давно неактивная сессия.

    config WCS_AUTH_SESSION_IDLE_TIMEOUT_MIN
        int "Сессия истекает после бездействия, минут"
        range 1 1440
        default 30

    config WCS_AUTH_FREE_ATTEMPTS
        int "Неверных попыток входа без паузы"
        range 1 20
        default 5

    config WCS_AUTH_LOCKOUT_BASE_S
        int "Первая пауза после превышения попыток, секунд"
        range 1 600
        default 5
        help
            Каждая следующая неверная попытка удваивает паузу.

    config WCS_AUTH_LOCKOUT_MAX_S
        int "Максимальная пауза, секунд"
        range 1 86400
        default 900

endmenu
```

## firmware/components/wcs_bastion/Kconfig
```kconfig
menu "ESP WCS: бастион"

    config WCS_BASTION_DEFAULT_PORT
        int "Порт бастиона, если в адресе он не указан"
        range 1 65535
        default 7443
        help
            Обычно ничем не занят: стандартные 443 и 8443 часто держат
            другие веб-серверы на той же машине.

    config WCS_BASTION_PROBE_TIMEOUT_MS
        int "Ожидание ответа при проверке доступности, мс"
        range 500 30000
        default 5000

endmenu
```

## firmware/components/wcs_console/Kconfig
```kconfig
menu "ESP WCS: консоль"

    config WCS_CONSOLE_HISTORY_KB
        int "История вывода консоли, КиБ (в PSRAM)"
        range 4 1024
        default 64

    config WCS_CONSOLE_RX_BUFFER
        int "Буфер приёма UART, байт"
        range 1024 32768
        default 4096

    config WCS_CONSOLE_TX_BUFFER
        int "Буфер передачи UART, байт"
        range 1024 65536
        default 8192

    config WCS_CONSOLE_MAX_LISTENERS
        int "Подписчиков на вывод консоли, не больше"
        range 1 8
        default 2

endmenu
```

## firmware/sdkconfig.defaults
```kconfig
CONFIG_IDF_TARGET="esp32s3"

CONFIG_ESPTOOLPY_FLASHSIZE_16MB=y
CONFIG_ESPTOOLPY_FLASHMODE_QIO=y

CONFIG_SPIRAM=y
CONFIG_SPIRAM_MODE_OCT=y
CONFIG_SPIRAM_SPEED_80M=y

CONFIG_ESP_DEFAULT_CPU_FREQ_MHZ_240=y

CONFIG_PARTITION_TABLE_CUSTOM=y
CONFIG_PARTITION_TABLE_CUSTOM_FILENAME="partitions.csv"

CONFIG_ESP_MAIN_TASK_STACK_SIZE=4096

CONFIG_HTTPD_MAX_REQ_HDR_LEN=2048

CONFIG_ESP_HTTPS_SERVER_ENABLE=y
CONFIG_MBEDTLS_X509_CREATE_C=y
CONFIG_MBEDTLS_X509_CRT_WRITE_C=y
CONFIG_MBEDTLS_EXTERNAL_MEM_ALLOC=y
CONFIG_LWIP_MAX_SOCKETS=16
CONFIG_MBEDTLS_SSL_PROTO_TLS1_3=y
```
